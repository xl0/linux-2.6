## arch/arm/mach-mx1/Kconfig
```kconfig
if ARCH_MX1

comment "MX1 platforms:"

config MACH_MXLADS
	bool

config ARCH_MX1ADS
	bool "MX1ADS platform"
	select MACH_MXLADS
	help
	  Say Y here if you are using Motorola MX1ADS/MXLADS boards

config MACH_SONY_PRS505
	bool "Sony PRS-505 book reader"
	help
	  Say Y here if you are using the Sony PRS-505 book reader.

config SONY_PRS505_DISPLAY
	tristate "Sony PRS-505 book reader display support"
	depends on MACH_SONY_PRS505
	help
	  Say Y here if you are using the Sony PRS-505 book reader and want
	  to have display working. Note that this only glue between metronomefb
	  and imxfb drivers. They also must be enabled.



config MACH_SCB9328
	bool "Synertronixx scb9328"
	help
	  Say Y here if you are using a Synertronixx scb9328 board

endif
```

## sound/soc/jz4740/Kconfig
```kconfig
config SND_JZ4740_SOC
	tristate "SoC Audio for Ingenic jz4740 chip"
	depends on (JZ4740_PAVO || JZ4740_N516 || JZ4725_DIPPER || JZ4720_VIRGO) && SND_SOC
	help
	  Say Y or M if you want to add support for codecs attached to
	  the Jz4740 AC97, I2S or SSP interface. You will also need
	  to select the audio interfaces to support below.

config SND_JZ4740_SOC_N516
	tristate "SoC Audio support for Hanvon N516 eBook reader"
	depends on SND_JZ4740_SOC && JZ4740_N516
	select SND_JZ4740_SOC_I2S
	select SND_SOC_JZCODEC
	help
	  Say Y if you want to add support for SoC audio of internal codec on Hanvon N516.

config SND_JZ4740_SOC_N526
	tristate "SoC Audio support for Hanvon N526 eBook reader"
	depends on SND_JZ4740_SOC && JZ4740_N526
	select SND_JZ4740_SOC_I2S
	select SND_SOC_JZCODEC
	help
	  Say Y if you want to enable support for SoC audio on the Hanvon N526.

config SND_JZ4740_SOC_I2S
	depends on SND_JZ4740_SOC
	tristate "SoC Audio (I2S protocol) for Ingenic jz4740 chip"
	help
	  Say Y if you want to use I2S protocol and I2S codec on Ingenic Jz4740 PAVO and N516 boards.
```
